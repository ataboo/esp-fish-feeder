## main/Kconfig.projbuild
```kconfig
menu "ESP-Fish-Feeder"
    config WIFI_SSID
        string "WiFi SSID"
        default "myssid"
        help
            SSID (network name).

    config WIFI_PASSWORD
        string "WiFi Password"
        default "mypassword"
        help
            WiFi password.

    config STEP1_GPIO
        int "Step 1 GPIO Pin"
        default 33
        range 0 36
        help
            GPIO pin for stepper 1.

    config STEP2_GPIO
        int "Step 2 GPIO Pin"
        default 25
        range 0 36
        help
            GPIO pin for stepper 2.

    config STEP3_GPIO
        int "Step 3 GPIO Pin"
        default 27
        range 0 36
        help
            GPIO pin for stepper 3.

    config STEP4_GPIO
        int "Step 4 GPIO Pin"
        default 14
        range 0 36
        help
            GPIO pin for stepper 4.

    config EXTEND_BTN_GPIO
        int "Extend button GPIO pin"
        default 15
        range 0 36
        help
            GPIO pin for extend button.

    config RETRACT_BTN_GPIO
        int "Retract btn GPIO pin"
        default 32
        range 0 36
        help
            GPIO pin for retract button.

    config LIMIT_GPIO
        int "Limit GPIO Pin"
        default 12
        range 0 36
        help
            GPIO pin for limit switch.

    config TIMEZONE
        string "Timezone"
        default "MST7MDT,M3.2.0/2,M11.1.0"
        help
            Timezone for light dimming.

    config EXTEND_BUTTON_ACTIVE
        bool "Extend button active"
        default true
        help
            Button 1 extends the fish feeder.


    config STEPS_PER_BUCKET
        int "Steps per bucket"
        default 340
        range 10 10000

    config FIRST_BUCKET_STEPS
        int "First bucket steps"
        default 420
        range 10 10000

    config BUCKET_COUNT
        int "Bucket count"
        default 10
        range 1 100

    config SLEEP_ACTIVE
        bool "Sleep active"
        default true
        help
            Put ESP32 to sleep between activations.

    config FEEDING_TIME
        int "Feeding time"
        default 900
        range 0 2359
        help
            Time for feeding as 4 digit in (hhmm)
endmenu
```
